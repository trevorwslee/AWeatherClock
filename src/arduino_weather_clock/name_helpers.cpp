#include <Arduino.h>
#include "name_helpers.h"

const char* countryCodeToCountryName(const String& countryCode) {
  if (countryCode == "AF") return "Afghanistan";
  else if (countryCode == "AX") return "Aland Islands";
  else if (countryCode == "AL") return "Albania";
  else if (countryCode == "DZ") return "Algeria";
  else if (countryCode == "AS") return "American Samoa";
  else if (countryCode == "AD") return "Andorra";
  else if (countryCode == "AO") return "Angola";
  else if (countryCode == "AI") return "Anguilla";
  else if (countryCode == "AQ") return "Antarctica";
  else if (countryCode == "AG") return "Antigua and Barbuda";
  else if (countryCode == "AR") return "Argentina";
  else if (countryCode == "AM") return "Armenia";
  else if (countryCode == "AW") return "Aruba";
  else if (countryCode == "AU") return "Australia";
  else if (countryCode == "AT") return "Austria";
  else if (countryCode == "AZ") return "Azerbaijan";
  else if (countryCode == "BS") return "Bahamas";
  else if (countryCode == "BH") return "Bahrain";
  else if (countryCode == "BD") return "Bangladesh";
  else if (countryCode == "BB") return "Barbados";
  else if (countryCode == "BY") return "Belarus";
  else if (countryCode == "BE") return "Belgium";
  else if (countryCode == "BZ") return "Belize";
  else if (countryCode == "BJ") return "Benin";
  else if (countryCode == "BM") return "Bermuda";
  else if (countryCode == "BT") return "Bhutan";
  else if (countryCode == "BO") return "Bolivia, Plurinational State of";
  else if (countryCode == "BQ") return "Bonaire, Sint Eustatius and Saba";
  else if (countryCode == "BA") return "Bosnia and Herzegovina";
  else if (countryCode == "BW") return "Botswana";
  else if (countryCode == "BV") return "Bouvet Island";
  else if (countryCode == "BR") return "Brazil";
  else if (countryCode == "IO") return "British Indian Ocean Territory";
  else if (countryCode == "BN") return "Brunei Darussalam";
  else if (countryCode == "BG") return "Bulgaria";
  else if (countryCode == "BF") return "Burkina Faso";
  else if (countryCode == "BI") return "Burundi";
  else if (countryCode == "KH") return "Cambodia";
  else if (countryCode == "CM") return "Cameroon";
  else if (countryCode == "CA") return "Canada";
  else if (countryCode == "CV") return "Cape Verde";
  else if (countryCode == "KY") return "Cayman Islands";
  else if (countryCode == "CF") return "Central African Republic";
  else if (countryCode == "TD") return "Chad";
  else if (countryCode == "CL") return "Chile";
  else if (countryCode == "CN") return "China";
  else if (countryCode == "CX") return "Christmas Island";
  else if (countryCode == "CC") return "Cocos (Keeling) Islands";
  else if (countryCode == "CO") return "Colombia";
  else if (countryCode == "KM") return "Comoros";
  else if (countryCode == "CG") return "Congo";
  else if (countryCode == "CD") return "Congo, The Democratic Republic of the";
  else if (countryCode == "CK") return "Cook Islands";
  else if (countryCode == "CR") return "Costa Rica";
  else if (countryCode == "CI") return "Côte d'Ivoire";
  else if (countryCode == "HR") return "Croatia";
  else if (countryCode == "CU") return "Cuba";
  else if (countryCode == "CW") return "Curaçao";
  else if (countryCode == "CY") return "Cyprus";
  else if (countryCode == "CZ") return "Czech Republic";
  else if (countryCode == "DK") return "Denmark";
  else if (countryCode == "DJ") return "Djibouti";
  else if (countryCode == "DM") return "Dominica";
  else if (countryCode == "DO") return "Dominican Republic";
  else if (countryCode == "EC") return "Ecuador";
  else if (countryCode == "EG") return "Egypt";
  else if (countryCode == "SV") return "El Salvador";
  else if (countryCode == "GQ") return "Equatorial Guinea";
  else if (countryCode == "ER") return "Eritrea";
  else if (countryCode == "EE") return "Estonia";
  else if (countryCode == "ET") return "Ethiopia";
  else if (countryCode == "FK") return "Falkland Islands (Malvinas)";
  else if (countryCode == "FO") return "Faroe Islands";
  else if (countryCode == "FJ") return "Fiji";
  else if (countryCode == "FI") return "Finland";
  else if (countryCode == "FR") return "France";
  else if (countryCode == "GF") return "French Guiana";
  else if (countryCode == "PF") return "French Polynesia";
  else if (countryCode == "TF") return "French Southern Territories";
  else if (countryCode == "GA") return "Gabon";
  else if (countryCode == "GM") return "Gambia";
  else if (countryCode == "GE") return "Georgia";
  else if (countryCode == "DE") return "Germany";
  else if (countryCode == "GH") return "Ghana";
  else if (countryCode == "GI") return "Gibraltar";
  else if (countryCode == "GR") return "Greece";
  else if (countryCode == "GL") return "Greenland";
  else if (countryCode == "GD") return "Grenada";
  else if (countryCode == "GP") return "Guadeloupe";
  else if (countryCode == "GU") return "Guam";
  else if (countryCode == "GT") return "Guatemala";
  else if (countryCode == "GG") return "Guernsey";
  else if (countryCode == "GN") return "Guinea";
  else if (countryCode == "GW") return "Guinea-Bissau";
  else if (countryCode == "GY") return "Guyana";
  else if (countryCode == "HT") return "Haiti";
  else if (countryCode == "HM") return "Heard Island and McDonald Islands";
  else if (countryCode == "VA") return "Holy See (Vatican City State)";
  else if (countryCode == "HN") return "Honduras";
  else if (countryCode == "HK") return "Hong Kong";
  else if (countryCode == "HU") return "Hungary";
  else if (countryCode == "IS") return "Iceland";
  else if (countryCode == "IN") return "India";
  else if (countryCode == "ID") return "Indonesia";
  else if (countryCode == "IR") return "Iran, Islamic Republic of";
  else if (countryCode == "IQ") return "Iraq";
  else if (countryCode == "IE") return "Ireland";
  else if (countryCode == "IM") return "Isle of Man";
  else if (countryCode == "IL") return "Israel";
  else if (countryCode == "IT") return "Italy";
  else if (countryCode == "JM") return "Jamaica";
  else if (countryCode == "JP") return "Japan";
  else if (countryCode == "JE") return "Jersey";
  else if (countryCode == "JO") return "Jordan";
  else if (countryCode == "KZ") return "Kazakhstan";
  else if (countryCode == "KE") return "Kenya";
  else if (countryCode == "KI") return "Kiribati";
  else if (countryCode == "KP") return "Korea, Democratic People's Republic of";
  else if (countryCode == "KR") return "Korea, Republic of";
  else if (countryCode == "KW") return "Kuwait";
  else if (countryCode == "KG") return "Kyrgyzstan";
  else if (countryCode == "LA") return "Lao People's Democratic Republic";
  else if (countryCode == "LV") return "Latvia";
  else if (countryCode == "LB") return "Lebanon";
  else if (countryCode == "LS") return "Lesotho";
  else if (countryCode == "LR") return "Liberia";
  else if (countryCode == "LY") return "Libya";
  else if (countryCode == "LI") return "Liechtenstein";
  else if (countryCode == "LT") return "Lithuania";
  else if (countryCode == "LU") return "Luxembourg";
  else if (countryCode == "MO") return "Macao";
  else if (countryCode == "MK") return "Macedonia, Republic of";
  else if (countryCode == "MG") return "Madagascar";
  else if (countryCode == "MW") return "Malawi";
  else if (countryCode == "MY") return "Malaysia";
  else if (countryCode == "MV") return "Maldives";
  else if (countryCode == "ML") return "Mali";
  else if (countryCode == "MT") return "Malta";
  else if (countryCode == "MH") return "Marshall Islands";
  else if (countryCode == "MQ") return "Martinique";
  else if (countryCode == "MR") return "Mauritania";
  else if (countryCode == "MU") return "Mauritius";
  else if (countryCode == "YT") return "Mayotte";
  else if (countryCode == "MX") return "Mexico";
  else if (countryCode == "FM") return "Micronesia, Federated States of";
  else if (countryCode == "MD") return "Moldova, Republic of";
  else if (countryCode == "MC") return "Monaco";
  else if (countryCode == "MN") return "Mongolia";
  else if (countryCode == "ME") return "Montenegro";
  else if (countryCode == "MS") return "Montserrat";
  else if (countryCode == "MA") return "Morocco";
  else if (countryCode == "MZ") return "Mozambique";
  else if (countryCode == "MM") return "Myanmar";
  else if (countryCode == "NA") return "Namibia";
  else if (countryCode == "NR") return "Nauru";
  else if (countryCode == "NP") return "Nepal";
  else if (countryCode == "NL") return "Netherlands";
  else if (countryCode == "NC") return "New Caledonia";
  else if (countryCode == "NZ") return "New Zealand";
  else if (countryCode == "NI") return "Nicaragua";
  else if (countryCode == "NE") return "Niger";
  else if (countryCode == "NG") return "Nigeria";
  else if (countryCode == "NU") return "Niue";
  else if (countryCode == "NF") return "Norfolk Island";
  else if (countryCode == "MP") return "Northern Mariana Islands";
  else if (countryCode == "NO") return "Norway";
  else if (countryCode == "OM") return "Oman";
  else if (countryCode == "PK") return "Pakistan";
  else if (countryCode == "PW") return "Palau";
  else if (countryCode == "PS") return "Palestinian Territory, Occupied";
  else if (countryCode == "PA") return "Panama";
  else if (countryCode == "PG") return "Papua New Guinea";
  else if (countryCode == "PY") return "Paraguay";
  else if (countryCode == "PE") return "Peru";
  else if (countryCode == "PH") return "Philippines";
  else if (countryCode == "PN") return "Pitcairn";
  else if (countryCode == "PL") return "Poland";
  else if (countryCode == "PT") return "Portugal";
  else if (countryCode == "PR") return "Puerto Rico";
  else if (countryCode == "QA") return "Qatar";
  else if (countryCode == "RE") return "Réunion";
  else if (countryCode == "RO") return "Romania";
  else if (countryCode == "RU") return "Russian Federation";
  else if (countryCode == "RW") return "Rwanda";
  else if (countryCode == "BL") return "Saint Barthélemy";
  else if (countryCode == "SH") return "Saint Helena, Ascension and Tristan da Cunha";
  else if (countryCode == "KN") return "Saint Kitts and Nevis";
  else if (countryCode == "LC") return "Saint Lucia";
  else if (countryCode == "MF") return "Saint Martin (French part)";
  else if (countryCode == "PM") return "Saint Pierre and Miquelon";
  else if (countryCode == "VC") return "Saint Vincent and the Grenadines";
  else if (countryCode == "WS") return "Samoa";
  else if (countryCode == "SM") return "San Marino";
  else if (countryCode == "ST") return "Sao Tome and Principe";
  else if (countryCode == "SA") return "Saudi Arabia";
  else if (countryCode == "SN") return "Senegal";
  else if (countryCode == "RS") return "Serbia";
  else if (countryCode == "SC") return "Seychelles";
  else if (countryCode == "SL") return "Sierra Leone";
  else if (countryCode == "SG") return "Singapore";
  else if (countryCode == "SX") return "Sint Maarten (Dutch part)";
  else if (countryCode == "SK") return "Slovakia";
  else if (countryCode == "SI") return "Slovenia";
  else if (countryCode == "SB") return "Solomon Islands";
  else if (countryCode == "SO") return "Somalia";
  else if (countryCode == "ZA") return "South Africa";
  else if (countryCode == "GS") return "South Georgia and the South Sandwich Islands";
  else if (countryCode == "ES") return "Spain";
  else if (countryCode == "LK") return "Sri Lanka";
  else if (countryCode == "SD") return "Sudan";
  else if (countryCode == "SR") return "Suriname";
  else if (countryCode == "SS") return "South Sudan";
  else if (countryCode == "SJ") return "Svalbard and Jan Mayen";
  else if (countryCode == "SZ") return "Swaziland";
  else if (countryCode == "SE") return "Sweden";
  else if (countryCode == "CH") return "Switzerland";
  else if (countryCode == "SY") return "Syrian Arab Republic";
  else if (countryCode == "TW") return "Taiwan, Province of China";
  else if (countryCode == "TJ") return "Tajikistan";
  else if (countryCode == "TZ") return "Tanzania, United Republic of";
  else if (countryCode == "TH") return "Thailand";
  else if (countryCode == "TL") return "Timor-Leste";
  else if (countryCode == "TG") return "Togo";
  else if (countryCode == "TK") return "Tokelau";
  else if (countryCode == "TO") return "Tonga";
  else if (countryCode == "TT") return "Trinidad and Tobago";
  else if (countryCode == "TN") return "Tunisia";
  else if (countryCode == "TR") return "Turkey";
  else if (countryCode == "TM") return "Turkmenistan";
  else if (countryCode == "TC") return "Turks and Caicos Islands";
  else if (countryCode == "TV") return "Tuvalu";
  else if (countryCode == "UG") return "Uganda";
  else if (countryCode == "UA") return "Ukraine";
  else if (countryCode == "AE") return "United Arab Emirates";
  else if (countryCode == "GB") return "United Kingdom";
  else if (countryCode == "US") return "United States";
  else if (countryCode == "UM") return "United States Minor Outlying Islands";
  else if (countryCode == "UY") return "Uruguay";
  else if (countryCode == "UZ") return "Uzbekistan";
  else if (countryCode == "VU") return "Vanuatu";
  else if (countryCode == "VE") return "Venezuela, Bolivarian Republic of";
  else if (countryCode == "VN") return "Viet Nam";
  else if (countryCode == "VG") return "Virgin Islands, British";
  else if (countryCode == "VI") return "Virgin Islands, U.S.";
  else if (countryCode == "WF") return "Wallis and Futuna";
  else if (countryCode == "EH") return "Western Sahara";
  else if (countryCode == "YE") return "Yemen";
  else if (countryCode == "ZM") return "Zambia";
  else if (countryCode == "ZW") return "Zimbabwe";
  else return nullptr;
}
